## uboot-port/board/annapurna/alpine/Kconfig
```kconfig
if TARGET_ALPINE_V2_UNVR

config SYS_BOARD
	default "alpine"

config SYS_VENDOR
	default "annapurna"

config SYS_CONFIG_NAME
	default "alpine"

endif
```

## uboot-port/drivers/crypto/al_ssm/Kconfig
```kconfig
# SPDX-License-Identifier: GPL-2.0-or-later
config AL_SSM
	bool "Annapurna Labs al_ssm crypto/RAID UDMA mem-to-mem test (iodma)"
	depends on AL_ETH
	help
	  Adds the `iodma` command: a mem-to-mem DMA self-test on the Alpine V2
	  SSM crypto/RAID engine (PCI 1c36:0022), which drives a SEPARATE al_udma
	  instance from al_eth's. Probes the endpoint, sets up a RAID-queue UDMA
	  ring in low DRAM, runs an AL_RAID_OP_MEM_CPY copy and verifies it, and
	  dumps the M2S engine state in the same format as al_eth so the two are
	  directly comparable (does THIS UDMA's descriptor read complete where the
	  eth's hangs, #90?).

	  Depends on AL_ETH: reuses that module's compiled udma/iofic HAL objects
	  and the al_unit_adapter_init stub. Only the SSM/RAID/m2m-udma glue is
	  added here. Build/diagnostic feature - no traffic path.
```

## uboot-port/drivers/net/al_eth/Kconfig
```kconfig
# SPDX-License-Identifier: GPL-2.0-or-later
config AL_ETH
	bool "Annapurna Labs al_eth (Alpine V2 / AL-324) Ethernet"
	depends on DM_ETH
	select PHYLIB
	help
	  DM_ETH driver for the Alpine V2 integrated Ethernet MAC. The 1G RGMII
	  port (UNVR eth1 @ PCI 1c36:0001, AR8033 PHY on MDIO addr 4) is always
	  built; AL_ETH_10G adds the SFP+ port.

	  The Annapurna HAL is NOT bundled here. It is staged at build time from
	  modules/al_eth/ - the single source shared with the Linux driver - so a
	  fix landed there is a fix here too (#256).

config AL_ETH_DEBUG
	bool "al_eth + al_serdes verbose HAL trace (-DDEBUG)"
	depends on AL_ETH
	help
	  Compile the al_eth and al_serdes directories with -DDEBUG, which turns
	  every HAL al_dbg() and driver debug()/dev_dbg() into a console print:
	  the full UDMA descriptor-fetch and adapter bring-up trace, plus every
	  SerDes PMA register access. Thousands of lines per boot.

	  Off by default. `eth diag` answers the usual "why is this port down"
	  question on demand; turn this on only to trace a bring-up live - e.g.
	  the last register logged before an SError names the faulting access.

config AL_ETH_10G
	bool "Annapurna Labs al_eth 10G SFP+ (eth2, 1c36:0002)"
	depends on AL_ETH
	select AL_SERDES
	help
	  DM_ETH driver for the 10G SFP+ port (UNVR eth2, PCI 1c36:0002) in
	  AL_ETH_MAC_MODE_10GbE_Serial (fixed 10.3125 Gbps, KR AN/LT off). Shares
	  the whole UDMA/EC datapath with the 1G port; adds only the SerDes lane
	  (via CONFIG_AL_SERDES) and the no-PHY PCS-block-lock link gate.
```

## uboot-port/drivers/phy/al_serdes/Kconfig
```kconfig
# SPDX-License-Identifier: GPL-2.0-or-later

config AL_SERDES
	bool "Annapurna Labs 25G SerDes + 10GBASE-R PCS (UNVR SFP+ bring-up)"
	depends on OF_CONTROL
	help
	  Bring up the Annapurna Labs (AL-324 / Alpine V2) 25G SerDes lane for
	  the UNVR's 10G SFP+ port at a FIXED 10.3125 Gbps (10GBASE-R), with KR
	  auto-neg and link-training DISABLED. Adds the `serdes` command to run
	  the init and read lane status (PLL lock, signal-detect, CDR lock,
	  rx-valid, PCS block-lock). Base addresses come from the device tree.

	  This is the SerDes/PCS (PMA) half of 10G ethernet only; the MAC/UDMA
	  come from the al_eth driver. Compile-only — the lane bring-up needs
	  on-hardware iteration.
```
